## meta-PandABlocks/conf/layer.conf
```bitbake
# We have a conf and classes directory, add to BBPATH
BBPATH .= ":${LAYERDIR}"

# We have recipes-* directories, add to BBFILES
BBFILES += "${LAYERDIR}/recipes-*/*/*.bb \
            ${LAYERDIR}/recipes-*/*/*.bbappend"

BBFILE_COLLECTIONS += "meta-PandABlocks"
BBFILE_PATTERN_meta-PandABlocks = "^${LAYERDIR}/"
BBFILE_PRIORITY_meta-PandABlocks = "6"

LAYERDEPENDS_meta-PandABlocks = "core xilinx petalinux"
LAYERSERIES_COMPAT_meta-PandABlocks = "kirkstone langdale"
LAYERVERSION_meta-PandABlocks = "1"
PBFPGA_BOOT_RELEASE_VERSION ??= "4.0"
PBFPGA_BOOT_VERSION ??= "${@d.getVar("PBFPGA_BOOT_RELEASE_VERSION")}"
```
